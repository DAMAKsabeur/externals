## board/freescale/common/s32g274/s32g274a_hper_gen2_uboot-5.10.120_defconfig
```kconfig
CONFIG_ARM=y
CONFIG_ARCH_S32G2=y
CONFIG_CUSTOM_SYS_TEXT_BASE=y
CONFIG_SYS_TEXT_BASE=0xffaa0000
CONFIG_CUSTOM_SYS_DATA_BASE=y
CONFIG_SYS_DATA_BASE=0xffa00000
CONFIG_EXTRA_KERNEL_BOOT_ARGS="hpe_args=${pfeaddr},${pfe1addr},${pfe2addr}"
CONFIG_ENV_OFFSET=0xa000
# CONFIG_SPI_FLASH_BAR is not set
CONFIG_ENV_IS_IN_MMC=y
CONFIG_ENV_SIZE=0x1e00
CONFIG_TARGET_S32G2XXAEVB=y
CONFIG_TARGET_S32GEN1_HPER_GEN2=y
CONFIG_HPER_GEN2_BOOTLOADER=y
CONFIG_HPER_GEN2_BANK_MGMT=y
CONFIG_ENV_VARS_UBOOT_CONFIG=y
# CONFIG_FIT is not set
CONFIG_BOOTDELAY=0
# CONFIG_CMD_EEPROM is not set
# CONFIG_CMD_MD5SUM is not set
# CONFIG_CMD_MEMTEST is not set
# CONFIG_CMD_LZMADEC is not set
# CONFIG_CMD_UNZIP is not set
# CONFIG_CMD_ADC is not set
# CONFIG_CMD_FUSE is not set
# CONFIG_CMD_GPIO is not set
# CONFIG_CMD_I2C is not set
# CONFIG_CMD_LOADB is not set
# CONFIG_CMD_LOADS is not set
# CONFIG_CMD_SF is not set
# CONFIG_CMD_EXT2 is not set
# CONFIG_CMD_EXT4 is not set
CONFIG_CMD_SECUREBOOT=y
# CONFIG_CMD_FAT is not set
# CONFIG_DOS_PARTITION is not set
CONFIG_EFI_PARTITION=y
# CONFIG_NET is not set
# CONFIG_ADC is not set
# CONFIG_SARADC_S32CC is not set
CONFIG_HSE_SECBOOT=y
CONFIG_CRYPTO_DEV_NXP_HSE_MU2=y
# CONFIG_SYS_I2C_MXC is not set
# CONFIG_DM_ETH is not set
# CONFIG_PCI is not set
# CONFIG_PINCTRL_GENERIC is not set
# CONFIG_PINCONF_RECURSIVE is not set
# CONFIG_DM_PMIC is not set
# CONFIG_USB is not set
# CONFIG_FS_FAT is not set
CONFIG_REGEX=y
CONFIG_SHA1=y
CONFIG_SHA256=y
# CONFIG_GZIP is not set
# CONFIG_EFI_LOADER is not set
CONFIG_DISPLAY_CPUINFO=n
CONFIG_NR_DRAM_BANKS=1
CONFIG_ARMV8_SEC_FIRMWARE_SUPPORT=y
```

## configs/freescale_s32g274a_hpcGenII_Deca_bsp34_defconfig
```kconfig
BR2_aarch64=y
BR2_ARM_FPU_VFPV3=y
BR2_PACKAGE_HOST_LINUX_HEADERS_CUSTOM_5_10=y
BR2_TOOLCHAIN_BUILDROOT_CXX=y
BR2_PACKAGE_HOST_GDB=y
BR2_TOOLCHAIN_GLIBC_GCONV_LIBS_COPY=y
BR2_TARGET_GENERIC_HOSTNAME="hpe-penta"
BR2_TARGET_GENERIC_ISSUE="Welcome to hpe-penta"
BR2_ROOTFS_MERGED_USR=y
BR2_SYSTEM_DEFAULT_PATH="/bin:/sbin:/usr/bin:/usr/sbin"
BR2_TARGET_TZ_INFO=y
BR2_ROOTFS_POST_IMAGE_SCRIPT="$(BR2_EXTERNAL_CONTINENTAL_PATH)/board/freescale/common/s32g274/scripts/genimage.sh"
BR2_ROOTFS_POST_SCRIPT_ARGS="$(HOST_DIR) $(BINARIES_DIR)"
BR2_LINUX_KERNEL=y
BR2_LINUX_KERNEL_CUSTOM_GIT=y
BR2_LINUX_KERNEL_CUSTOM_REPO_URL="https://source.codeaurora.org/external/autobsps32/linux"
BR2_LINUX_KERNEL_CUSTOM_REPO_VERSION="bsp34.0-5.10.120-rt"
BR2_LINUX_KERNEL_PATCH="$(BR2_EXTERNAL_CONTINENTAL_PATH)/board/freescale/common/s32g274/patches_5.10.120"
BR2_LINUX_KERNEL_USE_CUSTOM_CONFIG=y
BR2_LINUX_KERNEL_CUSTOM_CONFIG_FILE="$(BR2_EXTERNAL_CONTINENTAL_PATH)/board/freescale/common/s32g274/s32g274_linux_5.10.120_Deca_defconfig"
BR2_LINUX_KERNEL_DTS_SUPPORT=y
BR2_LINUX_KERNEL_CUSTOM_DTS_PATH="$(BR2_EXTERNAL_CONTINENTAL_PATH)/board/freescale/common/s32g274/s32g274_linux_5.10.120_device.dts"
BR2_LINUX_KERNEL_DTB_KEEP_DIRNAME=y
BR2_LINUX_KERNEL_NEEDS_HOST_OPENSSL=y
BR2_PACKAGE_BUSYBOX_SHOW_OTHERS=y
BR2_PACKAGE_GDB=y
BR2_PACKAGE_GDB_DEBUGGER=y
BR2_PACKAGE_CPIO=y
BR2_PACKAGE_SQUASHFS=y
BR2_PACKAGE_LIBP11=y
BR2_PACKAGE_LIBSSH=y
BR2_PACKAGE_LIBSSH_SERVER=y
BR2_PACKAGE_LIBSSH2=y
BR2_PACKAGE_LIBOPENSSL_BIN=y
BR2_PACKAGE_LIBOPENSSL_ENGINES=y
BR2_PACKAGE_LIBFUSE=y
BR2_PACKAGE_OPENSC=y
BR2_PACKAGE_EXPAT=y
BR2_PACKAGE_JSON_C=y
BR2_PACKAGE_GTEST=y
BR2_PACKAGE_GTEST_GMOCK=y
BR2_PACKAGE_LIBCAP=y
BR2_PACKAGE_LIBFFI=y
BR2_PACKAGE_HTOP=y
BR2_PACKAGE_KMOD=y
BR2_PACKAGE_KMOD_TOOLS=y
BR2_PACKAGE_UTIL_LINUX=y
BR2_PACKAGE_UTIL_LINUX_AGETTY=y
BR2_PACKAGE_UTIL_LINUX_FSCK=y
BR2_PACKAGE_UTIL_LINUX_MOUNT=y
BR2_TARGET_ROOTFS_EXT2=y
BR2_TARGET_ROOTFS_EXT2_4=y
BR2_TARGET_ROOTFS_EXT2_SIZE="120M"
BR2_TARGET_ROOTFS_SQUASHFS=y
# BR2_TARGET_ROOTFS_TAR is not set
BR2_TARGET_UBOOT=y
BR2_TARGET_UBOOT_BUILD_SYSTEM_KCONFIG=y
BR2_TARGET_UBOOT_CUSTOM_GIT=y
BR2_TARGET_UBOOT_CUSTOM_REPO_URL="git@github-vni.geo.conti.de:bs-g-nd-ptf-hpc-gen2/u-boot.git"
BR2_TARGET_UBOOT_CUSTOM_REPO_VERSION="feature/bsp34"
BR2_TARGET_UBOOT_USE_CUSTOM_CONFIG=y
BR2_TARGET_UBOOT_CUSTOM_CONFIG_FILE="$(BR2_EXTERNAL_CONTINENTAL_PATH)/board/freescale/common/s32g274/s32g274a_hper_gen2_uboot-5.10.120_defconfig"
BR2_PACKAGE_HOST_DOSFSTOOLS=y
BR2_PACKAGE_HOST_DTC=y
BR2_PACKAGE_HOST_GENIMAGE=y
BR2_PACKAGE_HOST_MTOOLS=y
BR2_PACKAGE_HOST_PYTHON3=y
BR2_PACKAGE_HOST_UBOOT_TOOLS=y
BR2_PACKAGE_HOST_UBOOT_TOOLS_ENVIMAGE=y
BR2_PACKAGE_HOST_UBOOT_TOOLS_ENVIMAGE_SOURCE="$(BR2_EXTERNAL_CONTINENTAL_PATH)/board/freescale/common/s32g274/u-boot_params.txt"
BR2_PACKAGE_HOST_UBOOT_TOOLS_ENVIMAGE_SIZE="0x2000"
BR2_PACKAGE_HOST_UBOOT_TOOLS_ENVIMAGE_REDUNDANT=y
BR2_PACKAGE_HOST_BOOT_IMAGE_GENERATION=y
```

## configs/freescale_s32g274a_hpcGenII_Penta_bsp34_defconfig
```kconfig
BR2_aarch64=y
BR2_ARM_FPU_VFPV3=y
BR2_PACKAGE_HOST_LINUX_HEADERS_CUSTOM_5_10=y
BR2_TOOLCHAIN_BUILDROOT_CXX=y
BR2_PACKAGE_HOST_GDB=y
BR2_TOOLCHAIN_GLIBC_GCONV_LIBS_COPY=y
BR2_TARGET_GENERIC_HOSTNAME="hpe-penta"
BR2_TARGET_GENERIC_ISSUE="Welcome to hpe-penta"
BR2_INIT_SYSTEMD=y
BR2_SYSTEM_DEFAULT_PATH="/bin:/sbin:/usr/bin:/usr/sbin"
BR2_ROOTFS_POST_IMAGE_SCRIPT="$(BR2_EXTERNAL_CONTINENTAL_PATH)/board/freescale/common/s32g274/scripts/genimage.sh"
BR2_ROOTFS_POST_SCRIPT_ARGS="$(HOST_DIR) $(BINARIES_DIR)"
BR2_LINUX_KERNEL=y
BR2_LINUX_KERNEL_CUSTOM_GIT=y
BR2_LINUX_KERNEL_CUSTOM_REPO_URL="https://github.com/nxp-auto-linux/linux.git"
BR2_LINUX_KERNEL_CUSTOM_REPO_VERSION="bsp34.0-5.10.120-rt"
BR2_LINUX_KERNEL_PATCH="$(BR2_EXTERNAL_CONTINENTAL_PATH)/board/freescale/common/s32g274/patches_5.10.120"
BR2_LINUX_KERNEL_USE_CUSTOM_CONFIG=y
BR2_LINUX_KERNEL_CUSTOM_CONFIG_FILE="$(BR2_EXTERNAL_CONTINENTAL_PATH)/board/freescale/common/s32g274/s32g274_linux_5.10.120_Penta_defconfig"
BR2_LINUX_KERNEL_DTS_SUPPORT=y
BR2_LINUX_KERNEL_CUSTOM_DTS_PATH="$(BR2_EXTERNAL_CONTINENTAL_PATH)/board/freescale/common/s32g274/s32g274_linux_5.10.120_device.dts"
BR2_LINUX_KERNEL_DTB_KEEP_DIRNAME=y
BR2_LINUX_KERNEL_NEEDS_HOST_OPENSSL=y
BR2_PACKAGE_BZIP2=y
BR2_PACKAGE_XZ=y
BR2_PACKAGE_ZSTD=y
BR2_PACKAGE_GDB=y
BR2_PACKAGE_GDB_DEBUGGER=y
BR2_PACKAGE_FINDUTILS=y
BR2_PACKAGE_FLEX=y
BR2_PACKAGE_GAWK=y
BR2_PACKAGE_LIBTOOL=y
BR2_PACKAGE_CPIO=y
BR2_PACKAGE_E2FSPROGS=y
BR2_PACKAGE_SQUASHFS=y
BR2_PACKAGE_XORG7=y
BR2_PACKAGE_XKEYBOARD_CONFIG=y
BR2_PACKAGE_DBUS_CPP=y
BR2_PACKAGE_KBD=y
BR2_PACKAGE_RNG_TOOLS=y
BR2_PACKAGE_SETSERIAL=y
BR2_PACKAGE_LZO=y
BR2_PACKAGE_CA_CERTIFICATES=y
BR2_PACKAGE_GNUTLS=y
BR2_PACKAGE_GNUTLS_OPENSSL=y
BR2_PACKAGE_GNUTLS_TOOLS=y
BR2_PACKAGE_GNUTLS_ENABLE_SSL2=y
BR2_PACKAGE_GNUTLS_ENABLE_GOST=y
BR2_PACKAGE_LIBGCRYPT=y
BR2_PACKAGE_LIBP11=y
BR2_PACKAGE_LIBSSH=y
BR2_PACKAGE_LIBSSH_SERVER=y
BR2_PACKAGE_LIBSSH_OPENSSL=y
BR2_PACKAGE_LIBSSH2=y
BR2_PACKAGE_LIBSSH2_OPENSSL=y
BR2_PACKAGE_LIBXCRYPT=y
BR2_PACKAGE_LIBOPENSSL_BIN=y
BR2_PACKAGE_LIBOPENSSL_ENGINES=y
BR2_PACKAGE_GDBM=y
BR2_PACKAGE_LIBFUSE=y
BR2_PACKAGE_LIBXKBCOMMON=y
BR2_PACKAGE_LIBXKBCOMMON_TOOLS=y
BR2_PACKAGE_OPENSC=y
BR2_PACKAGE_JSON_C=y
BR2_PACKAGE_LIBTIRPC=y
BR2_PACKAGE_LIBTIRPC_GSS=y
BR2_PACKAGE_CRACKLIB=y
BR2_PACKAGE_CRACKLIB_TOOLS=y
BR2_PACKAGE_CRACKLIB_FULL_DICT=y
BR2_PACKAGE_GTEST=y
BR2_PACKAGE_GTEST_GMOCK=y
BR2_PACKAGE_LIBCAP_NG=y
BR2_PACKAGE_SHARED_MIME_INFO=y
BR2_PACKAGE_DHCPCD=y
BR2_PACKAGE_IPUTILS=y
BR2_PACKAGE_BASH=y
BR2_PACKAGE_BASH_COMPLETION=y
BR2_PACKAGE_ACL=y
BR2_PACKAGE_COREUTILS=y
BR2_PACKAGE_HTOP=y
BR2_TARGET_ROOTFS_EXT2=y
BR2_TARGET_ROOTFS_EXT2_4=y
BR2_TARGET_ROOTFS_EXT2_SIZE="120M"
BR2_TARGET_ROOTFS_SQUASHFS=y
# BR2_TARGET_ROOTFS_TAR is not set
BR2_TARGET_ARM_TRUSTED_FIRMWARE=y
BR2_TARGET_ARM_TRUSTED_FIRMWARE_CUSTOM_GIT=y
BR2_TARGET_ARM_TRUSTED_FIRMWARE_CUSTOM_REPO_URL="git@github-vni.geo.conti.de:uic56995/arm-trusted-firmware.git"
BR2_TARGET_ARM_TRUSTED_FIRMWARE_CUSTOM_REPO_VERSION="main"
BR2_TARGET_ARM_TRUSTED_FIRMWARE_PLATFORM="s32g3xxaevb3"
BR2_TARGET_ARM_TRUSTED_FIRMWARE_FIP=y
BR2_TARGET_ARM_TRUSTED_FIRMWARE_BL31=y
BR2_TARGET_ARM_TRUSTED_FIRMWARE_UBOOT_AS_BL33=y
BR2_TARGET_ARM_TRUSTED_FIRMWARE_DEBUG=y
BR2_TARGET_UBOOT=y
BR2_TARGET_UBOOT_BUILD_SYSTEM_KCONFIG=y
BR2_TARGET_UBOOT_CUSTOM_GIT=y
BR2_TARGET_UBOOT_CUSTOM_REPO_URL="git@github-vni.geo.conti.de:uic56995/u-boot.git"
BR2_TARGET_UBOOT_CUSTOM_REPO_VERSION="main"
BR2_TARGET_UBOOT_USE_CUSTOM_CONFIG=y
BR2_TARGET_UBOOT_CUSTOM_CONFIG_FILE="$(BR2_EXTERNAL_CONTINENTAL_PATH)/board/freescale/common/S32G399/uboot/s32g3xxaevb3_defconfig"
BR2_TARGET_UBOOT_NEEDS_DTC=y
BR2_TARGET_UBOOT_NEEDS_PYLIBFDT=y
BR2_TARGET_UBOOT_NEEDS_OPENSSL=y
BR2_TARGET_UBOOT_NEEDS_UTIL_LINUX=y
BR2_TARGET_UBOOT_NEEDS_XXD=y
BR2_TARGET_UBOOT_CUSTOM_DTS_PATH="$(BR2_EXTERNAL_CONTINENTAL_PATH)/board/freescale/common/S32G399/uboot/s32g3xxa-evb3-s32g399aevb3.dts"
BR2_PACKAGE_HOST_DOSFSTOOLS=y
BR2_PACKAGE_HOST_GENIMAGE=y
BR2_PACKAGE_HOST_MTOOLS=y
BR2_PACKAGE_HOST_PYTHON3=y
BR2_PACKAGE_HOST_UBOOT_TOOLS=y
BR2_PACKAGE_HOST_UBOOT_TOOLS_ENVIMAGE=y
BR2_PACKAGE_HOST_UBOOT_TOOLS_ENVIMAGE_SOURCE="$(BR2_EXTERNAL_CONTINENTAL_PATH)/board/freescale/common/s32g274/u-boot_params.txt"
BR2_PACKAGE_HOST_UBOOT_TOOLS_ENVIMAGE_SIZE="0x2000"
BR2_PACKAGE_HOST_UBOOT_TOOLS_ENVIMAGE_REDUNDANT=y
BR2_PACKAGE_HOST_BOOT_IMAGE_GENERATION=y
```

## package/s32gx-mkimage/Config.in
```kconfig
config BR2_PACKAGE_HOST_S32GX_MKIMAGE
	bool "host s32gx-mkimage"
	help
	  s32gx-mkimage is used to combine input images and generate
	  final boot image with appropriate IVT set.

	  https://github.com/nxp-s32gx/s32gx-mkimage
```
