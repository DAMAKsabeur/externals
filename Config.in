## Config.in
```kconfig
source "$BR2_EXTERNAL_CONTINENTAL_PATH/package/boot_image_generation/Config.in"
source "$BR2_EXTERNAL_CONTINENTAL_PATH/package/s32gx-mkimage/Config.in"
```

## board/freescale/common/S32G399/uboot/s32g3_hper_gen2_vc_hpc_defconfig
```kconfig
CONFIG_ARM=y
CONFIG_ARCH_S32G3=y
CONFIG_CUSTOM_SYS_TEXT_BASE=y
CONFIG_SYS_TEXT_BASE=0xDFAA0000
CONFIG_CUSTOM_SYS_DATA_BASE=y
CONFIG_SYS_DATA_BASE=0xDFA00000
CONFIG_S32GEN1_HWCONFIG="pcie0:mode=sgmii,clock=int,fmhz=125,xpcs_mode=1;pcie1:mode=sgmii,clock=int,fmhz=125,xpcs_mode=2G5"
CONFIG_EXTRA_KERNEL_BOOT_ARGS="hpe_args=${pfeaddr},${pfe1addr},${pfe2addr}"
CONFIG_ENV_OFFSET=0xA000
CONFIG_ENV_IS_IN_MMC=y
CONFIG_ENV_SIZE=0x1E00
CONFIG_NR_DRAM_BANKS=1
CONFIG_BOOTARGS="root=/dev/ram rw earlycon"
CONFIG_TARGET_S32G3XXAEVB=y
CONFIG_TARGET_S32GEN1_HPER_GEN2=y
CONFIG_HPER_GEN2_BOOTLOADER=y
CONFIG_HPER_GEN2_BANK_MGMT=y
CONFIG_ENV_VARS_UBOOT_CONFIG=y
CONFIG_TOOLS_DEBUG=y
CONFIG_QSPI_BOOT=y
# CONFIG_DISPLAY_CPUINFO is not set
# CONFIG_CMD_FAT is not set
CONFIG_CMD_FS_GENERIC=y
CONFIG_ISO_PARTITION=y
CONFIG_EFI_PARTITION=y
# CONFIG_SARADC_S32CC is not set
CONFIG_HSE_SECBOOT=y
CONFIG_HSE_FW_FILE="/home/uic56995/Common/BuildRoot_Ext/externals/board/freescale/common/S32G399/uboot/s32cc_hse_fw.bin"
CONFIG_MMC_IO_VOLTAGE=y
CONFIG_MMC_HS200_SUPPORT=y
CONFIG_SPL_MMC_HS200_SUPPORT=y
# CONFIG_PHY_AQUANTIA is not set
# CONFIG_PHY_FIXED is not set
CONFIG_MII=y
# CONFIG_DM_PMIC_VR5510 is not set
# CONFIG_TIMER is not set
# CONFIG_EFI_LOADER is not set
```

## board/freescale/common/S32G399/uboot/s32g3_hper_gen2_xmi_defconfig
```kconfig
CONFIG_ARM=y
CONFIG_ARCH_S32G3=y
CONFIG_CUSTOM_SYS_TEXT_BASE=y
CONFIG_SYS_TEXT_BASE=0xDFAA0000
CONFIG_CUSTOM_SYS_DATA_BASE=y
CONFIG_SYS_DATA_BASE=0xDFA00000
CONFIG_S32GEN1_HWCONFIG="pcie0:mode=sgmii,clock=int,fmhz=125,xpcs_mode=1;pcie1:mode=sgmii,clock=int,fmhz=125,xpcs_mode=2G5"
CONFIG_EXTRA_KERNEL_BOOT_ARGS="hpe_args=${pfeaddr},${pfe1addr},${pfe2addr}"
CONFIG_ENV_OFFSET=0xA000
CONFIG_ENV_IS_IN_MMC=y
CONFIG_ENV_SIZE=0x1E00
CONFIG_NR_DRAM_BANKS=1
CONFIG_BOOTARGS="root=/dev/ram rw earlycon"
CONFIG_SF_DEFAULT_SPEED=40000000
CONFIG_SF_DEFAULT_MODE=0
CONFIG_TARGET_S32G3XXAEVB=y
CONFIG_TARGET_S32GEN1_HPER_GEN2=y
CONFIG_HPER_GEN2_BOOTLOADER=y
CONFIG_HPER_GEN2_BANK_MGMT=y
CONFIG_ENV_VARS_UBOOT_CONFIG=y
CONFIG_TOOLS_DEBUG=y
# CONFIG_DISPLAY_CPUINFO is not set
# CONFIG_CMD_EEPROM is not set
# CONFIG_CMD_LZMADEC is not set
# CONFIG_CMD_UNZIP is not set
# CONFIG_CMD_DHCP is not set
# CONFIG_CMD_FAT is not set
CONFIG_CMD_FS_GENERIC=y
CONFIG_ISO_PARTITION=y
CONFIG_EFI_PARTITION=y
# CONFIG_SARADC_S32CC is not set
# CONFIG_SYS_I2C_MXC is not set
# CONFIG_I2C_EEPROM is not set
CONFIG_MMC_IO_VOLTAGE=y
CONFIG_MMC_HS200_SUPPORT=y
CONFIG_SPL_MMC_HS200_SUPPORT=y
# CONFIG_PHY_AQUANTIA is not set
# CONFIG_PHY_FIXED is not set
CONFIG_MII=y
# CONFIG_DM_PMIC_VR5510 is not set
# CONFIG_SPI is not set
# CONFIG_TIMER is not set
# CONFIG_REGEX is not set
# CONFIG_EFI_LOADER is not set
CONFIG_QSPI_BOOT=y
CONFIG_HSE_SECBOOT=y
CONFIG_HSE_FW_FILE="$(BR2_EXTERNAL_CONTINENTAL_PATH)/board/freescale/common/S32G399/uboot/s32cc_hse_fw.bin"
CONFIG_USB_ULPI_VIEWPORT=y
```

## board/freescale/common/S32G399/uboot/s32g3xxaevb_defconfig
```kconfig
CONFIG_ARM=y
CONFIG_ARCH_S32G3=y
# CONFIG_SPI_FLASH_BAR is not set
CONFIG_TARGET_S32G3XXAEVB=y
CONFIG_HSE_SECBOOT=y
CONFIG_HSE_FW_FILE="/home/uic56995/rev1.1_s32g3xx_hse_fw_0.20.1_2.16.1_pb221011.bin.pink"
CONFIG_SD_BOOT=y
CONFIG_USB_ULPI_VIEWPORT=y
```

## board/freescale/common/S32G399/uboot/s32g3xxaevb_qspi_defconfig
```kconfig
CONFIG_ARM=y
CONFIG_ARCH_S32G3=y
# CONFIG_FSL_PFENG is not set
CONFIG_NR_DRAM_BANKS=1
CONFIG_TARGET_S32G3XXAEVB=y
CONFIG_QSPI_BOOT=y
CONFIG_LOG_DEFAULT_LEVEL=9
# CONFIG_I2C_EEPROM is not set
CONFIG_MMC_IO_VOLTAGE=y
CONFIG_SPL_MMC_HS200_SUPPORT=y
# CONFIG_PHY_AQUANTIA is not set
# CONFIG_PHY_FIXED is not set
CONFIG_MII=y
# CONFIG_DM_PMIC_VR5510 is not set
# CONFIG_TIMER is not set
CONFIG_USB_ULPI_VIEWPORT=y
# CONFIG_EFI_LOADER is not set
```
